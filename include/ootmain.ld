INCLUDE z64hdr/oot_u10/syms.ld

Audio_FadeOut = 0x800C7684;
func_8002BE04 = 0x8001F7A0;
func_80037F30 = 0x8002ACB8;
Matrix_GetCurrent = 0x800AA78C;
Lights_Draw = 0x80065D60;
Lights_New = 0x800667BC;

gActorXluSetup = 0x800E8510;
gFakeEntranceTable = 0x800F9C90;
gEntranceCutsceneTable = 0x800EFD04;
gMtxFClear = 0x800FEDF0;

osGetCount = 0x80004D50;
